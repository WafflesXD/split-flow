## boards/shields/splitflow/Kconfig.defconfig
```kconfig
if SHIELD_SPLITFLOW_LEFT

# Name must be less than 16 characters long!
config ZMK_KEYBOARD_NAME
    default "Split Flow"

config ZMK_SPLIT_ROLE_CENTRAL
    default y

endif

if SHIELD_SPLITFLOW_LEFT || SHIELD_SPLITFLOW_RIGHT

config ZMK_SPLIT
    default y

endif
```
